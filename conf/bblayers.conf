## conf/bblayers.conf
```bitbake
# POKY_BBLAYERS_CONF_VERSION is increased each time build/conf/bblayers.conf
# changes incompatibly
POKY_BBLAYERS_CONF_VERSION = "2"

BBPATH = "${TOPDIR}"
BBFILES ?= ""

BBLAYERS ?= " \
  /home/rpi-user/poky/meta \
  /home/rpi-user/poky/meta-poky \
  /home/rpi-user/poky/meta-yocto-bsp \
  /home/rpi-user/meta-raspberrypi \
  /home/rpi-user/meta-qt6 \
  /home/rpi-user/meta-estevtech-rpi-qt \
  "
```

## conf/layer.conf
```bitbake
# We have a conf and classes directory, add to BBPATH
BBPATH .= ":${LAYERDIR}"

# We have recipes-* directories, add to BBFILES
BBFILES += "${LAYERDIR}/recipes-*/*/*.bb \
            ${LAYERDIR}/recipes-*/*/*.bbappend"

BBFILE_COLLECTIONS += "meta-estervtech"
BBFILE_PATTERN_meta-estervtech = "^${LAYERDIR}/"
BBFILE_PRIORITY_meta-estervtech = "6"

LAYERDEPENDS_meta-estervtech = "core"
LAYERSERIES_COMPAT_meta-estervtech ="scarthgap"
```
